## arch/arm/mach-mx28/Kconfig
```kconfig
choice
	prompt "Select i.MXS board type"

config MACH_MX28EVK
	bool "Freescale MX28 EVK board"
	depends on ARCH_MX28
	select USB_ARCH_HAS_EHCI

config MACH_MX28_CANBY
	bool "Reach Freescale MX28 Canby board"
	depends on ARCH_MX28
	select USB_ARCH_HAS_EHCI

endchoice

if MACH_MX28_CANBY

choice
	prompt "Select G2C J9 Option"

config MX28_CANBY_SPI
	bool "Set J9 for SPI"
	depends on ARCH_MX28

config MX28_CANBY_AUART2
	bool "Set J9 for AUART2"
	depends on ARCH_MX28

endchoice

endif

config VECTORS_PHY_ADDR
	int "vectors address"
	default 0
	help
	  This config set vectors table is located which physical address

config MXS_TIMER_WITH_MACH
	bool "System Timer support Compare Match interrupt"
	default y

config MEM_mDDR
	bool "Memory type is mDDR"
	depends on ARCH_MX28
	help
	  Say Y to select mDDR memory
```
