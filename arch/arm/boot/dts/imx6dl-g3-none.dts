/*
 * Copyright 2019 Reach Technology.
 *
 * This program is free software; you can redistribute it and/or modify
 * it under the terms of the GNU General Public License version 2 as
 * published by the Free Software Foundation.
 *
 */
/dts-v1/;
#include "imx6dl.dtsi"
#include "imx6qdl-g3.dtsi"

/ {
    
	model = "Reach i.MX6 G3 Board, no display";
	compatible = "rd6,imx6dl-rd6", "fsl,imx6dl";

};
