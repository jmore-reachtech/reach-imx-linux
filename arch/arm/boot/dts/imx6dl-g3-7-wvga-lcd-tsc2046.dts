/*
 * Copyright 2020 Reach Technology.
 *
 * This program is free software; you can redistribute it and/or modify
 * it under the terms of the GNU General Public License version 2 as
 * published by the Free Software Foundation.
 *
 */
/dts-v1/;
#include "imx6dl.dtsi"
#include "imx6qdl-g3.dtsi"

/ {
    
	model = "Reach i.MX6 G3 Board, 7 inch resistive touchscreen";
	compatible = "rd6,imx6dl-rd6", "fsl,imx6dl";

	lcd@0 {
		status = "okay";
	};
};

&mxcfb1 {
	disp_dev = "lcd";
	interface_pix_fmt = "RGB666";
	mode_str ="LCD-SVGA";
	status = "okay";
};

&tsc2046 {
	status = "okay";
};
