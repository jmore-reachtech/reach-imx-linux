/*
 * Copyright 2018 Reach Technology.
 *
 * Author: Jeff Horn <jeff.horn@reachtech.com>
 *
 * This program is free software; you can redistribute it and/or modify
 * it under the terms of the GNU General Public License version 2 as
 * published by the Free Software Foundation.
 *
 */
/dts-v1/;
#include "imx6dl.dtsi"
#include "imx6qdl-rd6.dtsi"

/ {
    
	model = "Reach i.MX6 Dual Lite Board";
	compatible = "rd6,imx6dl-rd6", "fsl,imx6dl";

};

&mxcfb2 {
    status = "okay";
};

&focaltech_ts {
    status = "okay";
};

&ldb {
    status = "okay";
};
