/*
 * Copyright 2019 Reach Technology.
 *
 * This program is free software; you can redistribute it and/or modify
 * it under the terms of the GNU General Public License version 2 as
 * published by the Free Software Foundation.
 *
 */
/dts-v1/;
#include "imx6dl.dtsi"
#include "imx6qdl-g3.dtsi"

/ {
    
	model = "Reach i.MX6 G3 Board, 10.4 inch capacitive touchscreen";
	compatible = "rd6,imx6dl-rd6", "fsl,imx6dl";

	mxcfb1: fb@0 {
		disp_dev = "ldb";
		interface_pix_fmt = "RGB24";
		mode_str ="LDB-XGA";
		status = "okay";
	};
};

&ldb {
	ipu_id = <0>;
	disp_id = <0>;
	ext_ref = <1>;
	mode = "sin0";
	sec_ipu_id = <0>;
	sec_disp_id = <0>;
	channel_mapping = "JEIDA";
	status = "okay";
};
